## Documentation/devicetree/bindings/iio/frequency/adi,ad9783.yaml
```yaml
# SPDX-License-Identifier: (GPL-2.0-only OR BSD-2-Clause)
# Copyright 2022 Analog Devices Inc.
%YAML 1.2
---
$id: http://devicetree.org/schemas/bindings/iio/adc/adi,ad9783.yaml#
$schema: http://devicetree.org/meta-schemas/core.yaml#

title: Analog Devices AD9783 DAC family device driver

maintainers:
  - Sergiu Cuciurean <sergiu.cuciurean@analog.com>

description: |
  The AD9780/AD9781/AD9783 include pin-compatible, high
  dynamic range, dual digital-to-analog converters (DACs) with
  12-/14-/16-bit resolutions, and sample rates of up to 500 MSPS.

notes: |
  This device depends on the AXI-ADC IP core. Please refer to:

  http://devicetree.org/schemas/iio/adc/adi,axi-adc.yaml
  https://wiki.analog.com/resources/fpga/docs/axi_adc_ip

properties:
  compatible:
    enum:
      - adi,ad9780
      - adi,ad9781
      - adi,ad9783

  reg:
    description:
      SPI chip select number for the device
    maxItems: 1

  spi-max-frequency:
    description: Maximum SPI clocking speed of device in Hz

  clocks:
    description:
      DAC sampling clock input

  clocks-names:
    description:
      DAC sampling clock target name
    const: dac_clk

required:
  - compatible
  - reg
  - clocks
  - clock-names

examples:
  dts: |
    ad9783_spi: adc@0 {
      compatible = "adi,ad9783";
      reg = <0>;
      spi-max-freequency = <10000000>;
      clocks = <&ad9783_clk>;
      clock-names = "dac_clk";
    };
```
